## board/atmark-techno/armadillo-640/Kconfig
```kconfig
if TARGET_ARMADILLO_640

config SYS_BOARD
	default "armadillo-640"

config SYS_VENDOR
	default "atmark-techno"

config SYS_CONFIG_NAME
	default "armadillo-640"

config IMX_CONFIG
	default "board/atmark-techno/armadillo-640/imximage.cfg"

choice
        prompt "Console UART select"
        default CONSOLE_UART1

config CONSOLE_UART1
       bool "UART1"

config CONSOLE_UART3
       bool "UART3"
endchoice

config WLAN_RTC_OPTION_MODULE_INIT_ONOFF
       bool "Waking up by WLAN/RTC Option Module's ONOFF pin operation"
       help
         This config needs Armadillo-640 WLAN/RTC Option Module whose
         JP1 is shorted. Armadillo-640 can wake up from power-off
         state by receiving the alarm signal that Armadillo-640
         WLAN/RTC Option Module send via ONOFF signal
         line(CON9_11). This function can be enabled by setting U-Boot
         Environment Variable "stop_nr3225sa_alarm".

         If say 'y' here, the default value of "stop_nr3225sa_alarm"
         is set to "yes".

config PF3000_LOW_POWER_MODE_ENABLE
       bool "Enable Low Power Mode during standby mode"
       help
         This function can be enabled by setting U-Boot Environment
         Variable "enable_pf3000_lpm".
         In the low power mode, the power consumption of the PF3000
         decreases by about 25 mW. However, because the power supply
         capacity drops, it may not work properly.

         If say 'y' here, the default value of "enable_pf3000_lpm" is
         set to "yes".
endif
```

## configs/armadillo-640_defconfig
```kconfig
CONFIG_ARM=y
CONFIG_SYS_THUMB_BUILD=y
# CONFIG_SPL_USE_ARCH_MEMCPY is not set
# CONFIG_SPL_USE_ARCH_MEMSET is not set
CONFIG_ARCH_MX6=y
CONFIG_SYS_TEXT_BASE=0x87800000
CONFIG_TARGET_ARMADILLO_640=y
# CONFIG_CMD_BMODE is not set
CONFIG_NXP_BOARD_REVISION=y
# CONFIG_LOCALVERSION_AUTO is not set
# CONFIG_CC_OPTIMIZE_FOR_SIZE is not set
CONFIG_SYS_MALLOC_F=y
# CONFIG_EXPERT is not set
# CONFIG_ARCH_FIXUP_FDT_MEMORY is not set
CONFIG_SD_BOOT=y
CONFIG_BOOTDELAY=0
CONFIG_BOARD_EARLY_INIT_F=y
CONFIG_CMD_CONFIG=y
# CONFIG_CMD_CONSOLE is not set
# CONFIG_CMD_ELF is not set
# CONFIG_CMD_GO is not set
# CONFIG_CMD_IMI is not set
# CONFIG_CMD_XIMG is not set
CONFIG_CMD_GREPENV=y
CONFIG_CRC32_VERIFY=y
CONFIG_LOOPW=y
CONFIG_CMD_MD5SUM=y
CONFIG_MD5SUM_VERIFY=y
CONFIG_CMD_MEMINFO=y
CONFIG_CMD_SHA1SUM=y
CONFIG_SHA1SUM_VERIFY=y
CONFIG_CMD_STRINGS=y
# CONFIG_CMD_FLASH is not set
CONFIG_CMD_MMC=y
CONFIG_CMD_PART=y
CONFIG_CMD_USB=y
# CONFIG_CMD_ITEST is not set
# CONFIG_CMD_SOURCE is not set
# CONFIG_CMD_SETEXPR is not set
CONFIG_CMD_DHCP=y
# CONFIG_CMD_NFS is not set
CONFIG_CMD_PING=y
CONFIG_CMD_CACHE=y
# CONFIG_CMD_MISC is not set
CONFIG_CMD_TIMER=y
CONFIG_CMD_EXT2=y
CONFIG_CMD_EXT4=y
CONFIG_CMD_EXT4_WRITE=y
CONFIG_CMD_FAT=y
CONFIG_CMD_FS_GENERIC=y
CONFIG_CMD_FS_UUID=y
CONFIG_ENV_IS_IN_MMC=y
CONFIG_NET_RANDOM_ETHADDR=y
CONFIG_SYS_I2C_MXC=y
CONFIG_PHYLIB=y
CONFIG_PHY_SMSC=y
CONFIG_NETDEVICES=y
CONFIG_FEC_MXC=y
CONFIG_MXC_UART=y
CONFIG_USB=y
CONFIG_USB_STORAGE=y
CONFIG_OF_LIBFDT=y
```
